## apps/canopen_slave_gpio/sdkconfig.defaults
```kconfig
CONFIG_IDF_TARGET="esp32s3"
CONFIG_PARTITION_TABLE_CUSTOM=y
CONFIG_PARTITION_TABLE_CUSTOM_FILENAME="../../custom_partition_esp32s3.csv"
CONFIG_ESPTOOLPY_FLASHSIZE_8MB=y
CONFIG_FREERTOS_HZ=1000

CONFIG_UC2_NODE_ROLE=2
CONFIG_UC2_CORE_DEBUG_LEVEL=0
CONFIG_UC2_CAN_BUS_ENABLED=y
CONFIG_UC2_CAN_CONTROLLER_CANOPEN=y
CONFIG_UC2_MESSAGE_CONTROLLER=y
CONFIG_UC2_DIGITAL_IN_CONTROLLER=y
CONFIG_UC2_DIGITAL_OUT_CONTROLLER=y
CONFIG_UC2_GPIO_CAN_SLAVE_CONTROLLER=y
CONFIG_UC2_I2C_MASTER=y
CONFIG_TWAI_SUPPRESS_DEPRECATE_WARN=y
```
